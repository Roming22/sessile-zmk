#define COMBO_PI 20

// Visit https://github.com/urob/zmk-helpers/blob/main/docs/core_helpers.md#zmk_combo for more information on the zmk_combo macro.

#include "combos/0_alpha.dtsi"
#include "combos/1_fn_num.dtsi"
#include "combos/2_symbol.dtsi"
#include "combos/5_gaming.dtsi"
